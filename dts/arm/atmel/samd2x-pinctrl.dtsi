/*
 * Copyright (c) 2021 Gerson Fernando Budke
 *
 * SPDX-License-Identifier: Apache-2.0
 */

#include "pinctrl_atmel_sam.h"

/ {
	soc {
		pinctrl@41004400 {
			/* instance, signal, port, pin, peripheral [, flags] */
			DT_ATMEL_PORT(sercom0, pad0, a,  4, d, pinmux-enable);
			DT_ATMEL_PORT(sercom0, pad1, a,  5, d, pinmux-enable);
			DT_ATMEL_PORT(sercom0, pad2, a,  6, d, pinmux-enable);
			DT_ATMEL_PORT(sercom0, pad3, a,  7, d, pinmux-enable);
			DT_ATMEL_PORT(sercom0, pad0, a,  8, c, pinmux-enable);
			DT_ATMEL_PORT(sercom0, pad1, a,  9, c, pinmux-enable);
			DT_ATMEL_PORT(sercom0, pad2, a, 10, c, pinmux-enable);
			DT_ATMEL_PORT(sercom0, pad3, a, 11, c, pinmux-enable);
			DT_ATMEL_PORT(sercom1, pad0, a,  0, d, pinmux-enable);
			DT_ATMEL_PORT(sercom1, pad1, a,  1, d, pinmux-enable);
			DT_ATMEL_PORT(sercom1, pad0, a, 30, d, pinmux-enable);
			DT_ATMEL_PORT(sercom1, pad1, a, 31, d, pinmux-enable);
			DT_ATMEL_PORT(sercom1, pad0, a, 16, c, pinmux-enable);
			DT_ATMEL_PORT(sercom1, pad1, a, 17, c, pinmux-enable);
			DT_ATMEL_PORT(sercom1, pad2, a, 18, c, pinmux-enable);
			DT_ATMEL_PORT(sercom1, pad3, a, 19, c, pinmux-enable);
			DT_ATMEL_PORT(sercom2, pad0, a,  8, d, pinmux-enable);
			DT_ATMEL_PORT(sercom2, pad1, a,  9, d, pinmux-enable);
			DT_ATMEL_PORT(sercom2, pad2, a, 10, d, pinmux-enable);
			DT_ATMEL_PORT(sercom2, pad3, a, 11, d, pinmux-enable);
			DT_ATMEL_PORT(sercom2, pad0, a, 12, c, pinmux-enable);
			DT_ATMEL_PORT(sercom2, pad1, a, 13, c, pinmux-enable);
			DT_ATMEL_PORT(sercom2, pad2, a, 14, c, pinmux-enable);
			DT_ATMEL_PORT(sercom2, pad3, a, 15, c, pinmux-enable);
			DT_ATMEL_PORT(sercom3, pad0, a, 16, d, pinmux-enable);
			DT_ATMEL_PORT(sercom3, pad1, a, 17, d, pinmux-enable);
			DT_ATMEL_PORT(sercom3, pad2, a, 18, d, pinmux-enable);
			DT_ATMEL_PORT(sercom3, pad3, a, 19, d, pinmux-enable);
			DT_ATMEL_PORT(sercom3, pad2, a, 20, d, pinmux-enable);
			DT_ATMEL_PORT(sercom3, pad3, a, 21, d, pinmux-enable);
			DT_ATMEL_PORT(sercom3, pad0, a, 22, c, pinmux-enable);
			DT_ATMEL_PORT(sercom3, pad1, a, 23, c, pinmux-enable);
			DT_ATMEL_PORT(sercom3, pad2, a, 24, c, pinmux-enable);
			DT_ATMEL_PORT(sercom3, pad3, a, 25, c, pinmux-enable);
			DT_ATMEL_PORT(sercom4, pad0, b,  8, d, pinmux-enable);
			DT_ATMEL_PORT(sercom4, pad1, b,  9, d, pinmux-enable);
			DT_ATMEL_PORT(sercom4, pad2, b, 10, d, pinmux-enable);
			DT_ATMEL_PORT(sercom4, pad3, b, 11, d, pinmux-enable);
			DT_ATMEL_PORT(sercom4, pad0, b, 12, c, pinmux-enable);
			DT_ATMEL_PORT(sercom4, pad1, b, 13, c, pinmux-enable);
			DT_ATMEL_PORT(sercom4, pad2, b, 14, c, pinmux-enable);
			DT_ATMEL_PORT(sercom4, pad3, b, 15, c, pinmux-enable);
			DT_ATMEL_PORT(sercom4, pad0, a, 12, d, pinmux-enable);
			DT_ATMEL_PORT(sercom4, pad1, a, 13, d, pinmux-enable);
			DT_ATMEL_PORT(sercom4, pad2, a, 14, d, pinmux-enable);
			DT_ATMEL_PORT(sercom4, pad3, a, 15, d, pinmux-enable);
			DT_ATMEL_PORT(sercom5, pad0, b, 16, c, pinmux-enable);
			DT_ATMEL_PORT(sercom5, pad1, b, 17, c, pinmux-enable);
			DT_ATMEL_PORT(sercom5, pad2, a, 20, c, pinmux-enable);
			DT_ATMEL_PORT(sercom5, pad3, a, 21, c, pinmux-enable);
			DT_ATMEL_PORT(sercom5, pad0, a, 22, d, pinmux-enable);
			DT_ATMEL_PORT(sercom5, pad1, a, 23, d, pinmux-enable);
			DT_ATMEL_PORT(sercom5, pad2, a, 24, d, pinmux-enable);
			DT_ATMEL_PORT(sercom5, pad3, a, 25, d, pinmux-enable);
			DT_ATMEL_PORT(sercom5, pad2, b, 22, d, pinmux-enable);
			DT_ATMEL_PORT(sercom5, pad3, b, 23, d, pinmux-enable);
			DT_ATMEL_PORT(sercom5, pad0, b, 30, d, pinmux-enable);
			DT_ATMEL_PORT(sercom5, pad1, b, 31, d, pinmux-enable);
			DT_ATMEL_PORT(sercom5, pad2, b,  0, d, pinmux-enable);
			DT_ATMEL_PORT(sercom5, pad3, b,  1, d, pinmux-enable);
			DT_ATMEL_PORT(sercom5, pad0, b,  2, d, pinmux-enable);
			DT_ATMEL_PORT(sercom5, pad1, b,  3, d, pinmux-enable);

			DT_ATMEL_PORT(adc,  chan0, a,   2, b, pinmux-enable);
			DT_ATMEL_PORT(adc,  chan1, a,   3, b, pinmux-enable);
			DT_ATMEL_PORT(adc,  chan2, b,   8, b, pinmux-enable);
			DT_ATMEL_PORT(adc,  chan3, b,   9, b, pinmux-enable);
			DT_ATMEL_PORT(adc,  chan4, a,   4, b, pinmux-enable);
			DT_ATMEL_PORT(adc,  chan5, a,   5, b, pinmux-enable);
			DT_ATMEL_PORT(adc,  chan6, a,   6, b, pinmux-enable);
			DT_ATMEL_PORT(adc,  chan7, a,   7, b, pinmux-enable);
			DT_ATMEL_PORT(adc,  chan8, b,   0, b, pinmux-enable);
			DT_ATMEL_PORT(adc,  chan9, b,   1, b, pinmux-enable);
			DT_ATMEL_PORT(adc, chan10, b,   2, b, pinmux-enable);
			DT_ATMEL_PORT(adc, chan11, b,   3, b, pinmux-enable);
			DT_ATMEL_PORT(adc, chan12, b,   4, b, pinmux-enable);
			DT_ATMEL_PORT(adc, chan13, b,   5, b, pinmux-enable);
			DT_ATMEL_PORT(adc, chan14, b,   6, b, pinmux-enable);
			DT_ATMEL_PORT(adc, chan15, b,   7, b, pinmux-enable);
			DT_ATMEL_PORT(adc, chan16, a,   8, b, pinmux-enable);
			DT_ATMEL_PORT(adc, chan17, a,   9, b, pinmux-enable);
			DT_ATMEL_PORT(adc, chan18, a,  10, b, pinmux-enable);
			DT_ATMEL_PORT(adc, chan19, a,  11, b, pinmux-enable);
		};
	};
};
