## dts/bindings/adc/atmel,sam0-adc.yaml
```yaml
# Copyright (c) 2019 Derek Hageman <hageman@inthat.cloud>
# SPDX-License-Identifier: Apache-2.0

description: Atmel SAM0 family ADC

compatible: "atmel,sam0-adc"

include: adc-controller.yaml

properties:
    reg:
      required: true

    interrupts:
      required: true

    clocks:
      required: true

    clock-names:
      required: true

    gclk:
      type: int
      required: true
      description: generic clock generator source

    prescaler:
      type: int
      required: true
      description: clock prescaler divisor applied to the generic clock

    "#io-channel-cells":
      const: 1

    calib-offset:
      type: int
      required: false
      description: |
        bit position offset in NVM SW Calib for start of ADC0 BIASCOMP field.
        This property is expected to be set on SAM{D,E}5x family of SoCs.
        For ADC0 this should be 0, and for ADC1 this should be 14.
      enum:
        - 0
        - 14
    pinctrl-0:
      type: phandles
      description: |
        PIO pin configuration for adc pin and channel.  We expect that
        the phandles will reference pinctrl nodes.  These nodes will
        have a nodelabel that matches the Atmel SoC HAL defines and
        be of the form p<port><pin><periph>_<chan>_<signal>.

        For example the I2C0 on SAMD21 would be
           pinctrl-0 = <&pa9d_adc_chan19>;

      required: true

io-channel-cells:
    - input
```

## dts/bindings/i2c/atmel,sam0-i2c.yaml
```yaml
# Copyright (c) 2019 Derek Hageman <hageman@inthat.cloud>
# SPDX-License-Identifier: Apache-2.0

description: Atmel SAM0 series SERCOM I2C node

compatible: "atmel,sam0-i2c"

include: i2c-controller.yaml

properties:
    reg:
      required: true

    interrupts:
      required: true

    clocks:
      required: true

    clock-names:
      required: true

    dmas:
      description: |
        Optional TX & RX dma specifiers.  Each specifier will have a phandle
        reference to the dmac controller, the channel number, and peripheral
        trigger source.

        For example dmas for TX, RX on SERCOM3
           dmas = <&dmac 0 0xb>, <&dmac 0 0xa>;

    dma-names:
      description: |
        Required if the dmas property exists.  This should be "tx" and "rx"
        to match the dmas property.

        For example
           dma-names = "tx", "rx";
    pinctrl-0:
      type: phandles
      description: |
        PIO pin configuration for SCL & SDA signals.  We expect that
        the phandles will reference pinctrl nodes.  These nodes will
        have a nodelabel that matches the Atmel SoC HAL defines and
        be of the form p<port><pin><periph>_<inst>_<signal>.

        For example the I2C0 on SAMD21 would be
           pinctrl-0 = <&pa9d_sercom2_pad1 &pa8d_sercom2_pad0>;

      required: true
```
